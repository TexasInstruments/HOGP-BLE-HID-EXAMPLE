/**
 * @cliArgs --board "/ti/boards/CC26X2R1_LAUNCHXL" --product "simplelink_cc13x2_26x2_sdk@5.10.00.48"
 * @versions {"data":"2021031521","timestamp":"2021031521","tool":"1.8.0+1863","templates":null}
 */

/**
 * Import the modules used in this configuration.
 */
const ble         = scripting.addModule("/ti/ble5stack/ble");
const CCFG        = scripting.addModule("/ti/devices/CCFG");
const rfdesign    = scripting.addModule("/ti/devices/radioconfig/rfdesign");
const Display     = scripting.addModule("/ti/display/Display");
const Display1    = Display.addInstance();
const AESCCM      = scripting.addModule("/ti/drivers/AESCCM");
const AESCCM1     = AESCCM.addInstance();
const AESCTRDRBG  = scripting.addModule("/ti/drivers/AESCTRDRBG");
const AESCTRDRBG1 = AESCTRDRBG.addInstance();
const AESECB      = scripting.addModule("/ti/drivers/AESECB");
const AESECB1     = AESECB.addInstance();
const ECDH        = scripting.addModule("/ti/drivers/ECDH");
const ECDH1       = ECDH.addInstance();
const GPIO        = scripting.addModule("/ti/drivers/GPIO");
const GPIO1       = GPIO.addInstance();
const GPIO2       = GPIO.addInstance();
const NVS         = scripting.addModule("/ti/drivers/NVS");
const NVS1        = NVS.addInstance();
const Power       = scripting.addModule("/ti/drivers/Power");
const RF          = scripting.addModule("/ti/drivers/RF");
const RTOS        = scripting.addModule("/ti/drivers/RTOS");
const TRNG        = scripting.addModule("/ti/drivers/TRNG");
const TRNG1       = TRNG.addInstance();

/**
 * Write custom configuration values to the imported modules.
 */
ble.lockProject                                     = true;
ble.L2CAPCOC                                        = true;
ble.defaultTxPower                                  = "HCI_EXT_TX_POWER_4_DBM";
ble.deviceName                                      = "HID Keyboard";
ble.addressMode                                     = "ADDRMODE_RANDOM";
ble.randomAddress                                   = "c0:cd:c4:c3:c2:c1";
ble.maxConnNum                                      = 1;
ble.maxPDUNum                                       = 255;
ble.keyDistList                                     = ["GAPBOND_KEYDIST_MIDKEY","GAPBOND_KEYDIST_MSIGN","GAPBOND_KEYDIST_SSIGN"];
ble.tbmActiveItemsOnly                              = false;
ble.numOfAdvSets                                    = 3;
ble.bondIOCaps                                      = "GAPBOND_IO_CAP_NO_INPUT_NO_OUTPUT";
ble.radioConfig.codeExportConfig.$name              = "ti_devices_radioconfig_code_export_param0";
ble.connUpdateParamsPeripheral.$name                = "ti_ble5stack_general_ble_conn_update_params0";
ble.connUpdateParamsPeripheral.reqMinConnInt        = 7.5;
ble.connUpdateParamsPeripheral.reqMaxConnInt        = 7.5;
ble.connUpdateParamsPeripheral.reqConnTo            = 5000;
ble.advSet1.$name                                   = "ti_ble5stack_broadcaster_advertisement_set0";
ble.advSet1.advParam1.$name                         = "ti_ble5stack_broadcaster_advertisement_params0";
ble.advSet1.advParam1.name                          = "advParamsInitial";
ble.advSet1.advParam1.primIntMin                    = 30;
ble.advSet1.advParam1.primIntMax                    = 50;
ble.advSet1.advData1.$name                          = "ti_ble5stack_broadcaster_advertisement_data0";
ble.advSet1.advData1.name                           = "advData";
ble.advSet1.advData1.GAP_ADTYPE_FLAGS               = true;
ble.advSet1.advData1.advertisingFlags               = ["GAP_ADTYPE_FLAGS_BREDR_NOT_SUPPORTED","GAP_ADTYPE_FLAGS_LIMITED"];
ble.advSet1.advData1.GAP_ADTYPE_16BIT_COMPLETE      = true;
ble.advSet1.advData1.numOfUUIDs16Complete           = 2;
ble.advSet1.advData1.UUID016Complete                = 0x1812;
ble.advSet1.advData1.UUID116Complete                = 0x180F;
ble.advSet1.advData1.GAP_ADTYPE_APPEARANCE          = true;
ble.advSet1.advData1.appearanceValue                = 0x3C2;
ble.advSet1.scanRes1.$name                          = "ti_ble5stack_broadcaster_advertisement_data1";
ble.advSet1.scanRes1.GAP_ADTYPE_LOCAL_NAME_COMPLETE = true;
ble.advSet1.scanRes1.completeLocalName              = "HID Keyboard";
ble.advSet1.scanRes1.name                           = "scanData";
ble.advSet2.$name                                   = "ti_ble5stack_broadcaster_advertisement_set1";
ble.advSet2.advParam2.$name                         = "ti_ble5stack_broadcaster_advertisement_params1";
ble.advSet2.advParam2.name                          = "advParamsHigh";
ble.advSet2.advParam2.primIntMin                    = 20;
ble.advSet2.advParam2.primIntMax                    = 30;
ble.advSet2.advData2.$name                          = "ti_ble5stack_broadcaster_advertisement_data2";
ble.advSet2.advData2.GAP_ADTYPE_FLAGS               = true;
ble.advSet2.advData2.advertisingFlags               = ["GAP_ADTYPE_FLAGS_BREDR_NOT_SUPPORTED","GAP_ADTYPE_FLAGS_LIMITED"];
ble.advSet2.advData2.GAP_ADTYPE_16BIT_MORE          = true;
ble.advSet2.advData2.numOfUUIDs16More               = 2;
ble.advSet2.advData2.UUID016More                    = 0x1812;
ble.advSet2.advData2.UUID116More                    = 0x180F;
ble.advSet2.advData2.GAP_ADTYPE_APPEARANCE          = true;
ble.advSet2.advData2.appearanceValue                = 0x3C2;
ble.advSet2.scanRes2.$name                          = "ti_ble5stack_broadcaster_advertisement_data3";
ble.advSet2.scanRes2.GAP_ADTYPE_LOCAL_NAME_COMPLETE = true;
ble.advSet2.scanRes2.completeLocalName              = "HID Keyboard";
ble.advSet3.$name                                   = "ti_ble5stack_broadcaster_advertisement_set2";
ble.advSet3.advParam3.$name                         = "ti_ble5stack_broadcaster_advertisement_params2";
ble.advSet3.advParam3.name                          = "advParamsLow";
ble.advSet3.advParam3.primIntMin                    = 1000;
ble.advSet3.advParam3.primIntMax                    = 1000;
ble.advSet3.advData3.$name                          = "ti_ble5stack_broadcaster_advertisement_data4";
ble.advSet3.advData3.GAP_ADTYPE_LOCAL_NAME_SHORT    = true;
ble.advSet3.advData3.GAP_ADTYPE_FLAGS               = true;
ble.advSet3.advData3.advertisingFlags               = ["GAP_ADTYPE_FLAGS_BREDR_NOT_SUPPORTED","GAP_ADTYPE_FLAGS_LIMITED"];
ble.advSet3.advData3.GAP_ADTYPE_16BIT_MORE          = true;
ble.advSet3.advData3.numOfUUIDs16More               = 2;
ble.advSet3.advData3.UUID016More                    = 0x1812;
ble.advSet3.advData3.UUID116More                    = 0x180F;
ble.advSet3.advData3.GAP_ADTYPE_APPEARANCE          = true;
ble.advSet3.advData3.appearanceValue                = 0x3C2;
ble.advSet3.scanRes3.$name                          = "ti_ble5stack_broadcaster_advertisement_data5";
ble.advSet3.scanRes3.GAP_ADTYPE_LOCAL_NAME_COMPLETE = true;
ble.advSet3.scanRes3.completeLocalName              = "HID Keyboard";
scripting.suppress("The example app code handles 2 advertisement sets\. Please make sure to update the example app code according to the configured number of sets\.",ble,"numOfAdvSets");

CCFG.enableBootloader         = true;
CCFG.enableBootloaderBackdoor = true;
CCFG.dioBootloaderBackdoor    = 13;
CCFG.levelBootloaderBackdoor  = "Active low";
CCFG.ccfgTemplate.$name       = "ti_devices_CCFGTemplate0";

Display1.$name                          = "CONFIG_Display_0";
Display1.$hardware                      = system.deviceData.board.components.XDS110UART;
Display1.enableANSI                     = true;
Display1.uartBufferSize                 = 128;
Display1.uart.$name                     = "CONFIG_DISPLAY_UART";
Display1.uart.txPinInstance.outputState = "High";
Display1.uart.txPinInstance.$name       = "CONFIG_PIN_UART_TX";
Display1.uart.rxPinInstance.$name       = "CONFIG_PIN_UART_RX";

AESCCM1.$name = "CONFIG_AESCCM0";

AESCTRDRBG1.$name              = "CONFIG_AESCTRDRBG_0";
AESCTRDRBG1.aesctrObject.$name = "CONFIG_AESCTR_0";

AESECB1.$name = "CONFIG_AESECB0";

ECDH1.$name = "CONFIG_ECDH0";

GPIO1.$hardware         = system.deviceData.board.components["BTN-1"];
GPIO1.mode              = "Dynamic";
GPIO1.$name             = "CONFIG_GPIO_BTN1";
GPIO1.pinInstance.$name = "CONFIG_PIN_BTN1";

GPIO2.$hardware         = system.deviceData.board.components["BTN-2"];
GPIO2.mode              = "Dynamic";
GPIO2.$name             = "CONFIG_GPIO_BTN2";
GPIO2.pinInstance.$name = "CONFIG_PIN_BTN2";

NVS1.$name                    = "CONFIG_NVSINTERNAL";
NVS1.internalFlash.$name      = "ti_drivers_nvs_NVSCC26XX0";
NVS1.internalFlash.regionBase = 0x48000;
NVS1.internalFlash.regionSize = 0x4000;

TRNG1.$name = "CONFIG_TRNG_0";

/**
 * Pinmux solution for unlocked pins/peripherals. This ensures that minor changes to the automatic solver in a future
 * version of the tool will not impact the pinmux you originally saw.  These lines can be completely deleted in order to
 * re-solve from scratch.
 */
Display1.uart.uart.$suggestSolution       = "UART1";
Display1.uart.uart.txPin.$suggestSolution = "boosterpack.4";
Display1.uart.uart.rxPin.$suggestSolution = "boosterpack.3";
GPIO1.gpioPin.$suggestSolution            = "boosterpack.13";
GPIO2.gpioPin.$suggestSolution            = "boosterpack.12";
